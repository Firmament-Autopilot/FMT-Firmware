/***************************************************************************//**
* \file bootloader.icf
* \version 1.0.0
*
* Linker file for the IAR compiler.
*
* The main purpose of the linker script is to describe how the sections in the
* input files should be mapped into the output file, and to control the memory
* layout of the output file.
*
*
* \note The linker files included with the PDL template projects must be generic
* and handle all common use cases. Your project may not use every section
* defined in the linker files. In that case you may see warnings during the
* build process. In your project, you can simply comment out or remove the
* relevant code in the linker file.
*
********************************************************************************
* \copyright
* Copyright (c) (2020-2025), Cypress Semiconductor Corporation (an Infineon company) or
* an affiliate of Cypress Semiconductor Corporation.
* SPDX-License-Identifier: Apache-2.0
*
* Licensed under the Apache License, Version 2.0 (the "License");
* you may not use this file except in compliance with the License.
* You may obtain a copy of the License at
*
*     http://www.apache.org/licenses/LICENSE-2.0
*
* Unless required by applicable law or agreed to in writing, software
* distributed under the License is distributed on an "AS IS" BASIS,
* WITHOUT WARRANTIES OR CONDITIONS OF ANY KIND, either express or implied.
* See the License for the specific language governing permissions and
* limitations under the License.
*******************************************************************************/

/* Include the device memory definitions generated by the Device Configurator */
include  "../../config/GeneratedSource/cymem_ilinkarm_CM33_0_S.icf";

/* Define the stack size for the application
  To set stack size in application add makefile ldflags: --config_def APP_MSP_STACK_SIZE=<CUSTOM_VALUE> */
if (!isdefinedsymbol(APP_MSP_STACK_SIZE))
{
  /* default stack size */
  define symbol APP_MSP_STACK_SIZE = 0x00002000;
}
define symbol __ICFEDIT_size_cstack__ = APP_MSP_STACK_SIZE;

/* Defines the minimum heap size. The actual heap size will be expanded to the end of the stack region */
if (!isdefinedsymbol(HEAP_SIZE))
{
  /* default heap size */
  define symbol HEAP_SIZE = 0x00001000;
}
define symbol __ICFEDIT_size_heap__ = HEAP_SIZE;

/* Device definitions */
define symbol VECTORS_ALIGNMENT = 0x400;

/* The memory space denoting the maximum possible amount of addressable memory */
define memory mem with size = 4G;

/* The size of the MCU boot header area at the start of main code region */
define symbol MCUBOOT_HEADER_SIZE = 0x400;

/* The size of the signature trail area at the end of main code region */
define symbol SIGNATURE_TRAIL_SIZE = 0x400;

/* Include the memory regions generated by the Device Configurator.
  This file contains the memory region definitions for the device,
  which are used to define the memory layout in this linker script. */

include  "../../config/GeneratedSource/cymem_ilinkarm_regions_CM33_0_S.icf";

/* Block definitions */

/* Define a block for performance-sensitive or critical functions that need to be executed in SRAM */
define block RAM_APP with alignment = 4
{
  section .cy_sram_code,
  section .cy_ramfunc,
  section .text.cy_os_common,
  readwrite code object cy_smif.*,
  readwrite code object cy_smif_sfdp.*,
  readwrite code object cy_smif_memslot.*,
  readwrite code object cy_smif_hb_flash.*,
  readwrite code object cy_syslib.*,
  readwrite code object cy_syslib_ext.*,
  readwrite code object mtb_hal_memoryspi.*,
  readwrite code object mtb_serial_memory.*,
  readwrite code object cy_gpio.*
};

/* Define the stack and heap blocks */
define block CSTACK with alignment = 8, size = __ICFEDIT_size_cstack__ { };
define block HEAP with expanding size, alignment = 8, minimum size = __ICFEDIT_size_heap__ { };

/* Define the RAM data and bss blocks */
define block RAM_DATA { readwrite section .data };
define block RAM_BSS { readwrite section .bss };
define block RAM_OTHER { readwrite section * };
define block RAM_NOINIT { readwrite section .noinit };
define block RAM with fixed order { block RAM_DATA, block RAM_OTHER, block RAM_NOINIT, block RAM_BSS };

/* Define the RAM vector block */
define block RAM_VECTOR with alignment = VECTORS_ALIGNMENT { section .intvec_ram };

/* Initialization */
do not initialize { section .noinit, section .intvec_ram, section .cy_sharedmem  };
initialize by copy
{
  readwrite,
  section .cy_sram_code,
  section .cy_ramfunc,
  section .text.cy_os_common,
  readonly object cy_smif.*,
  readonly object cy_smif_sfdp.*,
  readonly object cy_smif_memslot.*,
  readonly object cy_smif_hb_flash.*,
  readonly object cy_syslib.*,
  readonly object cy_syslib_ext.*,
  readonly object mtb_hal_memoryspi.*,
  readonly object mtb_serial_memory.*,
  readonly object cy_gpio.*
};

/* Placement */
/* Serial Memory Interface block #0 memory #1, 16 MB */
reserve region "MCUBOOT_HEADER" = [from start(bootloader_nvm_sel_S) size MCUBOOT_HEADER_SIZE];
/* A reserved region for the trail space for the signature used by the bootloader - do not place any code here */
reserve region "M33S_TRAILER" = [from (end(bootloader_nvm_sel_S) + 1 - SIGNATURE_TRAIL_SIZE) size SIGNATURE_TRAIL_SIZE];

place in bootloader_nvm_sel_S { first section .intvec, readonly };

define block RAM_CODE with fixed order { block RAM_VECTOR, block RAM_APP };

/* A piece intended for data placement */
place at start of m33s_data_S { block RAM_CODE };
place in          m33s_data_S { block RAM, block HEAP };
place at end   of m33s_data_S { block CSTACK };

/* A piece intended for secure shared RAM memory placement */
place in m33s_shared_S { section .cy_sharedmem_sec };

/* A piece intended for shared RAM memory placement where only the Cortex-M33 Non Secure can allocate data but all cores can access */
place in m33s_allocatable_shared_S { section .cy_sharedmem };

keep { section .intvec };
